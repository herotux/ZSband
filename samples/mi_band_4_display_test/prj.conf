## CMakeLists.txt
```
cmake_minimum_required(VERSION 3.20.0)
find_package(Zephyr REQUIRED HINTS $ENV{ZEPHYR_BASE})
project(mi_band_4_display_test)

target_sources(app PRIVATE src/main.c)
```

## prj.conf
```kconfig
CONFIG_DISPLAY=y
CONFIG_RM69XXX=y
CONFIG_LOG=y
CONFIG_DISPLAY_LOG_LEVEL_INF=y
CONFIG_MAIN_STACK_SIZE=4096

# BLE peripheral exposes a writable characteristic for phone time sync.
CONFIG_BT=y
CONFIG_BT_PERIPHERAL=y
CONFIG_BT_DEVICE_NAME="Mi Band 4 Clock"
CONFIG_BT_MAX_CONN=1
CONFIG_BT_MAX_PAIRED=1
CONFIG_BT_SMP=n
```

## src/main.c
```c
/*
 * SPDX-License-Identifier: Apache-2.0
 *
 * Mi Band 4 Jalali clock prototype.
 *
 * IMPORTANT: the DA14697 board currently has no validated RTC or phone-time
 * synchronization. The clock therefore starts from this firmware's build
 * timestamp (treated as UTC) plus Iran Standard Time (+03:30), then advances
 * using uptime. It is useful for validating the UI/display, not as an accurate
 * time source after flashing. Do not represent it as a production clock yet.
 */

#include <stdint.h>
#include <stddef.h>
#include <stdbool.h>
#include <zephyr/device.h>
#include <zephyr/bluetooth/bluetooth.h>
#include <zephyr/bluetooth/gatt.h>
#include <zephyr/sys/byteorder.h>
#include <zephyr/devicetree.h>
#include <zephyr/drivers/display.h>
#include <zephyr/kernel.h>
#include <zephyr/logging/log.h>
#include <zephyr/sys/util.h>

LOG_MODULE_REGISTER(mi_band_4_jalali_clock, LOG_LEVEL_INF);

#define DISPLAY_NODE DT_CHOSEN(zephyr_display)
#define DISPLAY_WIDTH 120U
#define DISPLAY_HEIGHT 240U
#define TIMEZONE_OFFSET_SECONDS (3 * 60 * 60 + 30 * 60)
#define RGB565(r, g, b) (uint16_t)((((r) & 0xF8U) << 8) | (((g) & 0xFCU) << 3) | ((b) >> 3))

#define COLOR_BG       RGB565(8, 13, 25)
#define COLOR_PANEL    RGB565(18, 28, 47)
#define COLOR_TEXT     RGB565(246, 249, 255)
#define COLOR_MUTED    RGB565(143, 161, 184)
#define COLOR_ACCENT   RGB565(56, 214, 190)
#define COLOR_RULE     RGB565(38, 57, 80)

static uint16_t framebuffer[DISPLAY_WIDTH * DISPLAY_HEIGHT];

/*
 * BLE time sync protocol:
 * Write exactly 10 bytes to the characteristic:
 *   bytes 0..7: Unix epoch seconds in UTC, unsigned little-endian
 *   bytes 8..9: phone UTC offset in minutes, signed little-endian
 * A companion phone app should write this on connect and periodically.
 */
static struct k_mutex clock_mutex;
static int64_t synced_local_epoch;
static int64_t sync_uptime_seconds;
static bool clock_is_synced;

static struct bt_uuid_128 clock_service_uuid =
    BT_UUID_INIT_128(BT_UUID_128_ENCODE(0x8d2f7b10, 0x6d3a, 0x4b19,
                                        0x9e2a, 0x73c4d5a6b701));
static struct bt_uuid_128 clock_time_uuid =
    BT_UUID_INIT_128(BT_UUID_128_ENCODE(0x8d2f7b11, 0x6d3a, 0x4b19,
                                        0x9e2a, 0x73c4d5a6b701));

static ssize_t write_clock_time(struct bt_conn *conn,
                                const struct bt_gatt_attr *attr,
                                const void *buf, uint16_t len,
                                uint16_t offset, uint8_t flags)
{
    const uint8_t *data = buf;
    uint64_t utc_epoch;
    int16_t utc_offset_minutes;

    ARG_UNUSED(conn);
    ARG_UNUSED(attr);
    ARG_UNUSED(flags);

    if (offset != 0U || len != 10U) {
        return BT_GATT_ERR(BT_ATT_ERR_INVALID_ATTRIBUTE_LEN);
    }

    utc_epoch = sys_get_le64(data);
    utc_offset_minutes = (int16_t)sys_get_le16(data + 8);

    /* Reject obviously invalid timestamps instead of displaying nonsense. */
    if (utc_epoch < 1577836800ULL || utc_epoch > 4102444800ULL ||
        utc_offset_minutes < -720 || utc_offset_minutes > 840) {
        return BT_GATT_ERR(BT_ATT_ERR_VALUE_NOT_ALLOWED);
    }

    k_mutex_lock(&clock_mutex, K_FOREVER);
    synced_local_epoch = (int64_t)utc_epoch +
                         (int64_t)utc_offset_minutes * 60;
    sync_uptime_seconds = k_uptime_get() / 1000;
    clock_is_synced = true;
    k_mutex_unlock(&clock_mutex);

    LOG_INF("Time synchronized over BLE (UTC offset %d min)",
            utc_offset_minutes);
    return len;
}

BT_GATT_SERVICE_DEFINE(clock_sync_service,
    BT_GATT_PRIMARY_SERVICE(&clock_service_uuid.uuid),
    BT_GATT_CHARACTERISTIC(&clock_time_uuid.uuid,
        BT_GATT_CHRC_WRITE | BT_GATT_CHRC_WRITE_WITHOUT_RESP,
        BT_GATT_PERM_WRITE, NULL, write_clock_time, NULL)
);

static int start_clock_ble(void)
{
    static const uint8_t ad_flags[] = {
        BT_LE_AD_GENERAL | BT_LE_AD_NO_BREDR,
    };
    static const uint8_t service_uuid_bytes[] = {
        BT_UUID_128_ENCODE(0x8d2f7b10, 0x6d3a, 0x4b19,
                           0x9e2a, 0x73c4d5a6b701),
    };
    static const uint8_t device_name[] = CONFIG_BT_DEVICE_NAME;
    static const struct bt_data ad[] = {
        BT_DATA(BT_DATA_FLAGS, ad_flags, sizeof(ad_flags)),
        BT_DATA(BT_DATA_UUID128_ALL, service_uuid_bytes,
                sizeof(service_uuid_bytes)),
    };
    static const struct bt_data sd[] = {
        BT_DATA(BT_DATA_NAME_COMPLETE, device_name, sizeof(device_name) - 1),
    };
    int err = bt_enable(NULL);

    if (err) {
        LOG_ERR("Bluetooth initialization failed: %d", err);
        return err;
    }

    err = bt_le_adv_start(BT_LE_ADV_CONN_FAST_1, ad, ARRAY_SIZE(ad),
                          sd, ARRAY_SIZE(sd));
    if (err) {
        LOG_ERR("Bluetooth advertising failed: %d", err);
        return err;
    }

    LOG_INF("BLE time sync ready; connect to Mi Band 4 Clock");
    return 0;
}

static int64_t current_local_epoch(int64_t fallback_epoch)
{
    int64_t epoch = fallback_epoch;

    k_mutex_lock(&clock_mutex, K_FOREVER);
    if (clock_is_synced) {
        epoch = synced_local_epoch +
                (k_uptime_get() / 1000 - sync_uptime_seconds);
    }
    k_mutex_unlock(&clock_mutex);

    return epoch;
}

/* Compact 5x7 bitmap font for digits and punctuation. */
static const uint8_t glyphs[12][7] = {
    {0x0E, 0x11, 0x13, 0x15, 0x19, 0x11, 0x0E}, /* 0 */
    {0x04, 0x0C, 0x04, 0x04, 0x04, 0x04, 0x0E}, /* 1 */
    {0x0E, 0x11, 0x01, 0x02, 0x04, 0x08, 0x1F}, /* 2 */
    {0x1E, 0x01, 0x01, 0x0E, 0x01, 0x01, 0x1E}, /* 3 */
    {0x02, 0x06, 0x0A, 0x12, 0x1F, 0x02, 0x02}, /* 4 */
    {0x1F, 0x10, 0x1E, 0x01, 0x01, 0x11, 0x0E}, /* 5 */
    {0x06, 0x08, 0x10, 0x1E, 0x11, 0x11, 0x0E}, /* 6 */
    {0x1F, 0x01, 0x02, 0x04, 0x08, 0x08, 0x08}, /* 7 */
    {0x0E, 0x11, 0x11, 0x0E, 0x11, 0x11, 0x0E}, /* 8 */
    {0x0E, 0x11, 0x11, 0x0F, 0x01, 0x02, 0x0C}, /* 9 */
    {0x00, 0x00, 0x04, 0x00, 0x04, 0x00, 0x00}, /* : */
    {0x00, 0x01, 0x02, 0x04, 0x08, 0x10, 0x00}, /* / */
};

static void fill_rect(int x, int y, int w, int h, uint16_t color)
{
    int x0 = MAX(x, 0);
    int y0 = MAX(y, 0);
    int x1 = MIN(x + w, (int)DISPLAY_WIDTH);
    int y1 = MIN(y + h, (int)DISPLAY_HEIGHT);

    for (int py = y0; py < y1; py++) {
        for (int px = x0; px < x1; px++) {
            framebuffer[(size_t)py * DISPLAY_WIDTH + (size_t)px] = color;
        }
    }
}

static void draw_char(char c, int x, int y, int scale, uint16_t color)
{
    int index;

    if (c >= '0' && c <= '9') {
        index = c - '0';
    } else if (c == ':') {
        index = 10;
    } else if (c == '/') {
        index = 11;
    } else {
        return;
    }

    for (int row = 0; row < 7; row++) {
        for (int col = 0; col < 5; col++) {
            if ((glyphs[index][row] & (1U << (4 - col))) != 0U) {
                fill_rect(x + col * scale, y + row * scale,
                          scale, scale, color);
            }
        }
    }
}

static int text_width(const char *s, int scale)
{
    int len = 0;

    while (s[len] != '\0') {
        len++;
    }

    return len == 0 ? 0 : len * 5 * scale + (len - 1) * scale;
}

static void draw_text(const char *s, int y, int scale, uint16_t color)
{
    int x = ((int)DISPLAY_WIDTH - text_width(s, scale)) / 2;

    while (*s != '\0') {
        draw_char(*s, x, y, scale, color);
        x += 6 * scale;
        s++;
    }
}

static bool is_leap_year(int year)
{
    return (year % 4 == 0 && year % 100 != 0) || (year % 400 == 0);
}

static int month_number(const char *mon)
{
    static const char *const months[] = {
        "Jan", "Feb", "Mar", "Apr", "May", "Jun",
        "Jul", "Aug", "Sep", "Oct", "Nov", "Dec"
    };

    for (int i = 0; i < 12; i++) {
        const char *a = mon;
        const char *b = months[i];
        if (a[0] == b[0] && a[1] == b[1] && a[2] == b[2]) {
            return i + 1;
        }
    }
    return 1;
}

static int64_t build_epoch_seconds(void)
{
    /* __DATE__ is "Mmm dd yyyy"; __TIME__ is "hh:mm:ss". */
    const char date[] = __DATE__;
    const char time[] = __TIME__;
    int year = (date[7] - '0') * 1000 + (date[8] - '0') * 100 +
               (date[9] - '0') * 10 + (date[10] - '0');
    int month = month_number(date);
    int day = (date[4] == ' ' ? 0 : date[4] - '0') * 10 + (date[5] - '0');
    int hour = (time[0] - '0') * 10 + (time[1] - '0');
    int minute = (time[3] - '0') * 10 + (time[4] - '0');
    int second = (time[6] - '0') * 10 + (time[7] - '0');
    int64_t days = 0;

    for (int y = 1970; y < year; y++) {
        days += is_leap_year(y) ? 366 : 365;
    }

    for (int m = 1; m < month; m++) {
        static const uint8_t month_days[] =
            {31, 28, 31, 30, 31, 30, 31, 31, 30, 31, 30, 31};
        days += month_days[m - 1];
        if (m == 2 && is_leap_year(year)) {
            days++;
        }
    }

    days += day - 1;
    return days * 86400 + hour * 3600 + minute * 60 + second;
}

static void gregorian_from_epoch(int64_t epoch, int *year, int *month,
                                 int *day, int *hour, int *minute, int *second)
{
    int64_t days = epoch / 86400;
    int64_t seconds = epoch % 86400;

    if (seconds < 0) {
        seconds += 86400;
        days--;
    }

    *hour = (int)(seconds / 3600);
    *minute = (int)((seconds % 3600) / 60);
    *second = (int)(seconds % 60);

    *year = 1970;
    while (days >= (is_leap_year(*year) ? 366 : 365)) {
        days -= is_leap_year(*year) ? 366 : 365;
        (*year)++;
    }

    *month = 1;
    while (true) {
        int mdays;
        switch (*month) {
        case 2: mdays = is_leap_year(*year) ? 29 : 28; break;
        case 4: case 6: case 9: case 11: mdays = 30; break;
        default: mdays = 31; break;
        }
        if (days < mdays) {
            break;
        }
        days -= mdays;
        (*month)++;
    }
    *day = (int)days + 1;
}

/* Gregorian to Jalali conversion using the 12053-day / 1461-day cycles. */
static void gregorian_to_jalali(int gy, int gm, int gd,
                                int *jy, int *jm, int *jd)
{
    static const int cumulative_days[] =
        {0, 31, 59, 90, 120, 151, 181, 212, 243, 273, 304, 334};
    int gy2 = gm > 2 ? gy + 1 : gy;
    int64_t days = 355666LL + 365LL * gy +
        (gy2 + 3) / 4 - (gy2 + 99) / 100 + (gy2 + 399) / 400 +
        gd + cumulative_days[gm - 1];

    *jy = -1595 + 33 * (int)(days / 12053);
    days %= 12053;
    *jy += 4 * (int)(days / 1461);
    days %= 1461;

    if (days > 365) {
        *jy += (int)((days - 1) / 365);
        days = (days - 1) % 365;
    }

    if (days < 186) {
        *jm = 1 + (int)(days / 31);
        *jd = 1 + (int)(days % 31);
    } else {
        *jm = 7 + (int)((days - 186) / 30);
        *jd = 1 + (int)((days - 186) % 30);
    }
}

static void format_number(char *out, int value, int digits)
{
    for (int i = digits - 1; i >= 0; i--) {
        out[i] = (char)('0' + value % 10);
        value /= 10;
    }
    out[digits] = '\0';
}

static int render_clock(const struct device *display, int64_t epoch)
{
    int gy, gm, gd, hour, minute, second;
    int jy, jm, jd;
    char time_text[9];
    char date_text[11];
    struct display_buffer_descriptor desc = {
        .width = DISPLAY_WIDTH,
        .height = DISPLAY_HEIGHT,
        .pitch = DISPLAY_WIDTH,
        .buf_size = sizeof(framebuffer),
    };

    gregorian_from_epoch(epoch, &gy, &gm, &gd, &hour, &minute, &second);
    gregorian_to_jalali(gy, gm, gd, &jy, &jm, &jd);

    format_number(&time_text[0], hour, 2);
    time_text[2] = ':';
    format_number(&time_text[3], minute, 2);
    time_text[5] = ':';
    format_number(&time_text[6], second, 2);
    time_text[8] = '\0';

    format_number(&date_text[0], jy, 4);
    date_text[4] = '/';
    format_number(&date_text[5], jm, 2);
    date_text[7] = '/';
    format_number(&date_text[8], jd, 2);
    date_text[10] = '\0';

    for (size_t i = 0; i < ARRAY_SIZE(framebuffer); i++) {
        framebuffer[i] = COLOR_BG;
    }

    fill_rect(8, 16, 104, 2, COLOR_RULE);
    fill_rect(8, 17, 4, 20, COLOR_ACCENT);
    draw_text(time_text, 78, 2, COLOR_TEXT);
    fill_rect(24, 111, 72, 1, COLOR_RULE);
    draw_text(date_text, 132, 1, COLOR_ACCENT);

    /* A subtle year-progress indicator derived from the Jalali day number. */
    {
        int day_of_year = jd;
        for (int m = 1; m < jm; m++) {
            day_of_year += (m <= 6) ? 31 : (m <= 11 ? 30 : 29);
        }
        fill_rect(18, 181, 84, 5, COLOR_PANEL);
        fill_rect(18, 181, (day_of_year * 84) / 366, 5, COLOR_ACCENT);
    }
    fill_rect(8, 222, 104, 2, COLOR_RULE);

    int ret = display_write(display, 0, 0, &desc, framebuffer);
    if (ret < 0) {
        LOG_ERR("Display write failed: %d", ret);
    }

    return ret;
}

int main(void)
{
    const struct device *display = DEVICE_DT_GET(DISPLAY_NODE);
    int ret;

    LOG_INF("Mi Band 4 Jalali clock starting");
    k_mutex_init(&clock_mutex);

    if (!device_is_ready(display)) {
        LOG_ERR("Chosen display device is not ready");
        return 1;
    }

    ret = display_set_pixel_format(display, PIXEL_FORMAT_RGB_565);
    if (ret < 0) {
        LOG_ERR("Could not select RGB565: %d", ret);
        return 1;
    }

    ret = display_blanking_off(display);
    if (ret < 0) {
        LOG_ERR("Could not unblank display: %d", ret);
        return 1;
    }

    const int64_t fallback_epoch = build_epoch_seconds() + TIMEZONE_OFFSET_SECONDS;
    const int64_t start_uptime = k_uptime_get() / 1000;

    ret = start_clock_ble();
    if (ret < 0) {
        LOG_WRN("BLE sync unavailable; using build timestamp until restart");
    }

    while (true) {
        int64_t elapsed = k_uptime_get() / 1000 - start_uptime;
        ret = render_clock(display, current_local_epoch(fallback_epoch + elapsed));
        if (ret < 0) {
            return 1;
        }
        k_sleep(K_SECONDS(1));
    }

    return 0;
}
```
